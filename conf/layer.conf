## conf/layer.conf
```bitbake
# We have a conf and classes directory, append to BBPATH
BBPATH .= ":${LAYERDIR}"

# We have a recipes directory, add to BBFILES
BBFILES += "${LAYERDIR}/recipes-*/*.bb ${LAYERDIR}/recipes-*/*.bbappend \
            ${LAYERDIR}/recipes-*/*/*.bb ${LAYERDIR}/recipes-*/*/*.bbappend \
            ${LAYERDIR}/recipes-*/*/*/*.bb ${LAYERDIR}/recipes-*/*/*/*.bbappend"

LOCALE_GENERATION_WITH_CROSS-LOCALEDEF_forcevariable = "0"

BBFILE_COLLECTIONS += "cuberevo-layer"
BBFILE_PATTERN_cuberevo-layer := "^${LAYERDIR}/"
BBFILE_PRIORITY_cuberevo-layer = "7"

DISTRO_VERSION ?= "Audioniek"

PREFERRED_VERSION_libnl ?= "3.2.29"
PREFERRED_VERSION_libarchive ?= "3.2.2"
PREFERRED_VERSION_libarchive-native ?= "3.2.2"
```
